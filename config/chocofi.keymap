/* source keypos definitions */
#include "../zmk-nodefree-config/keypos_def/keypos_36keys.h"

/* map Chocofi extra keys */

/* active bluetooth */
#define CONFIG_WIRELESS 1

/* source the main keymap */
#include "base.keymap"

/* use 5-column layout for Chocofi */
/* / { chosen { zmk,matrix_transform = &five_column_transform; }; }; */
